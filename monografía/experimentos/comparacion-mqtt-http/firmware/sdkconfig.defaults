## monografía/plataforma-comun/eco-mqtt/firmware/main/Kconfig.projbuild
```kconfig
menu "Eco MQTT"

    config ECO_BROKER_URI
        string "URI del broker"
        default "mqtt://10.0.2.2:1883"
        help
            En QEMU (red de usuario) la computadora anfitriona es 10.0.2.2.

    config ECO_NODE_ID
        string "Identificador del nodo (va en los tópicos)"
        default "n1"

    config ECO_WIFI_NO_PS
        bool "Desactivar el ahorro de energía del WiFi"
        default y
        depends on EXAMPLE_CONNECT_WIFI
        help
            Con el ahorro de energía por defecto la radio duerme entre beacons y
            la latencia sube a cientos de ms.

    config ECO_TAP
        bool "Varios nodos QEMU sobre tap + puente (IP fija, índice en la flash)"
        default n
        select ETH_USE_OPENETH

endmenu
```

## monografía/plataforma-comun/eco-mqtt/firmware/sdkconfig.defaults
```kconfig
CONFIG_IDF_TARGET="esp32"
CONFIG_ESPTOOLPY_FLASHSIZE_4MB=y
CONFIG_EXAMPLE_CONNECT_IPV6=n
```

## monografía/plataforma-comun/eco-mqtt/firmware/sdkconfig.defaults.qemu
```kconfig
CONFIG_EXAMPLE_CONNECT_WIFI=n
CONFIG_EXAMPLE_CONNECT_ETHERNET=y
CONFIG_EXAMPLE_USE_OPENETH=y
CONFIG_ETH_USE_SPI_ETHERNET=n
CONFIG_ECO_BROKER_URI="mqtt://10.0.2.2:1883"
```
